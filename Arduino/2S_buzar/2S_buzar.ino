/* Comment this out to disable prints and save space */
#define BLYNK_PRINT Serial


#include <ESP8266_Lib.h>
#include <BlynkSimpleShieldEsp8266.h>

// You should get Auth Token in the Blynk App.
// Go to the Project Settings (nut icon).
char auth[] = "61187f1e9f9d4cbdbb977aebc0f5ceb9";

// Your WiFi credentials.
// Set password to "" for open networks.
char ssid[] = "bld2-guest";
char pass[] = "MatsumotoWay";




const unsigned char extend1_raw[] PROGMEM = {
  0x80, 0x80, 0x80, 0x7f, 0x80, 0x7f, 0x80, 0x7f, 0x80, 0x7f, 0x80, 0x7f,
  0x7f, 0x80, 0x80, 0x80, 0x80, 0x80, 0x80, 0x80, 0x80, 0x80, 0x80, 0x80,
  0x80, 0x80, 0x7f, 0x80, 0x7f, 0x80, 0x7f, 0x80, 0x7f, 0x80, 0x7f, 0x80,
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  0x80, 0x80, 0x80, 0x7f, 0x80, 0x7f, 0x80, 0x7f, 0x80, 0x7f, 0x80, 0x7f
};




// Hardware Serial on Mega, Leonardo, Micro...
#define EspSerial Serial1

// or Software Serial on Uno, Nano...
//#include <SoftwareSerial.h>
//SoftwareSerial EspSerial(2, 3); // RX, TX

// Your ESP8266 baud rate:
#define ESP8266_BAUD 115200

ESP8266 wifi(&EspSerial);

void setup()
{
  // Debug console
  Serial.begin(9600);

  delay(10);

  pinMode(9, OUTPUT);
  TCCR2A = _BV(COM2B1) | _BV(WGM21) | _BV(WGM20);
  TCCR2B = _BV(CS20);

  // Set ESP8266 baud rate
  EspSerial.begin(ESP8266_BAUD);
  delay(10);

  Blynk.begin(auth, wifi, ssid, pass);
}



int i ;
int xbuf[40], ybuf[40],zbuf[40];
int counter = 0;
int cnt =0;
int flag = 0;
int ave = 0;
long x, y, z;
int xave=0,yave=0,zave=0;
int number = 1;

BLYNK_WRITE(V1) {
  switch ( param.asInt()) {
    case 1: { 
      Serial.println("ドアの開閉");
      number = 1;
      break;
    }
    case 2: {
      Serial.println("正解です");
      number = 2;
      break;
    }
    case 3: {
      Serial.println("いらっしゃいませ");
      number = 3;
      break;
    }
    case 4: {
      Serial.println("運命");
      number = 4;
      break;
    }
    case 5: {
      Serial.println("お後がよろしいようで");
      number = 5;
      break;
    }
  }
}

void loop()
{
  Blynk.run();
  
   x = y = z = 0;
   for (i=0; i<50; i++) {
    x = x + analogRead(1);
    y = y + analogRead(2);
    z = z + analogRead(3);
   }
   x = x / 50;
   y = y / 50;
   z = z / 50;

  xbuf[counter] = x;
  ybuf[counter] = y;
  zbuf[counter] = z;
  counter++;

  if ( cnt < 40) cnt++;

  if ( counter == 40) {
    counter = 0;
    flag = 1;
  }
  if (flag == 1) {
    xave = xaverage();
    yave = yaverage();
    zave = zaverage();
  }
  if ( (abs(x - xave)>15) || (abs(y - yave)>15) || (abs(z-zave)>15)) { 
    if (xave != 0) {
      if (cnt>=40) {
      play();
      cnt = 0;
      }
    }
   }

   int rotatex = (x-201)/1.517 - 90;
   Serial.print("X:");
   Serial.print(x);
   Serial.print(" ");
   Serial.print(rotatex);
   Serial.print("度");
   int rotatey = (y-205)/1.522 - 90;
   Serial.print("   Y:");
   Serial.print(y);
   Serial.print(" ");
   Serial.print(rotatey);
   Serial.println("度");
   //{int rotatez = (z-205)/1.522 - 90;
   //Serial.print("   Z:");
   //Serial.print(z);
   //Serial.print(" ");
   //Serial.print(rotatez);
   //Serial.println("度");}
   delay(5);

  
}


int xaverage() {
  int avex = 0;
  for ( int s = 0; s < 40; s++){
    avex = avex + xbuf[s];
  }
  avex = avex/40;
  return avex;
}
int yaverage() {
  int avey = 0;
  for ( int s = 0; s < 40; s++){
    avey = avey + ybuf[s];
  }
  avey = avey/40;
  return avey;
}
int zaverage() {
  int avez= 0;
  for (int s =0; s < 40; s++){
    avez = avez + zbuf[s];
  }
  avez = avez/40;
  return avez;
}



void play1() {
  for ( int i = 0; i < 5376; i++) {
    OCR2B = pgm_read_byte_near(&extend1_raw[i]);
    delayMicroseconds(125);
  }

}  
/*
void play2() {
  for ( int i = 0; i < 12058; i++) {
  OCR2B = pgm_read_byte_near(&decision_raw[i]);
    delayMicroseconds(125);
  }
  
}*/



void play3() {
  for ( int i = 0; i < 24000; i++) {
  OCR2B = pgm_read_byte_near(&famima_raw[i]);
    delayMicroseconds(125);
  }
  for ( int i = 0; i < 24000; i++) {
  OCR2B = pgm_read_byte_near(&famima2_raw[i]);
    delayMicroseconds(125);
  }
  for ( int i = 0; i < 8268; i++) {
  OCR2B = pgm_read_byte_near(&famima3_raw[i]);
    delayMicroseconds(125);
  }
}
/*
void play4() {
  for ( int i = 0; i < 24000; i++) {
  OCR2B = pgm_read_byte_near(&fate1_raw[i]);
    delayMicroseconds(125);
  }
  for ( int i = 0; i < 24000; i++) {
  OCR2B = pgm_read_byte_near(&fate2_raw[i]);
    delayMicroseconds(125);
  }
  for ( int i = 0; i < 8216; i++) {
  OCR2B = pgm_read_byte_near(&fate3_raw[i]);
    delayMicroseconds(125);
  }
}


void play5() {   //shouten
  for ( int i = 0; i < 23987; i++) {
    OCR2B = pgm_read_byte_near(&shouten1_raw[i]);
    delayMicroseconds(125);
  }
  for ( int i = 0; i < 24000; i++) {
    OCR2B = pgm_read_byte_near(&shouten2_raw[i]);
    delayMicroseconds(125);
  }
   for ( int i = 0; i < 1392 ; i++) {
    OCR2B = pgm_read_byte_near(&shouten3_raw[i]);
    delayMicroseconds(125);
  }
  
}  
*/

void play() {
  switch ( number ) {
    case 1: {
      play1();
      break;
    }
    case 2: {
     // play2();
      break;
    }
    case 3: {
      play3();
      break;
    }
    case 4: {
      //play4();
      break;
    }
    case 5: {
      //play5();
      break;
    }
  } 
}
